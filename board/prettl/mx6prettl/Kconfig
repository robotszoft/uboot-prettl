## board/prettl/mx6prettl/Kconfig
```kconfig
if TARGET_MX6PRETTL

config SYS_BOARD
	default "mx6prettl"

config SYS_VENDOR
	default "prettl"

config SYS_CONFIG_NAME
	default "mx6prettl"

endif
```

## configs/mx6dlprettl_defconfig
```kconfig
CONFIG_ARM=y
CONFIG_ARCH_MX6=y
CONFIG_TARGET_MX6PRETTL=y
CONFIG_SYS_EXTRA_OPTIONS="IMX_CONFIG=board/prettl/mx6prettl/mx6dlprettl.cfg,MX6DL"
# CONFIG_CMD_IMLS is not set
# CONFIG_CMD_FLASH is not set
CONFIG_SPI_FLASH=y
```
